## n/conf/bblayers.conf
```bitbake
# POKY_BBLAYERS_CONF_VERSION is increased each time build/conf/bblayers.conf
# changes incompatibly
POKY_BBLAYERS_CONF_VERSION = "2"

BBPATH = "${TOPDIR}"
BBFILES ?= ""

BBLAYERS ?= " \
  /home/kirbyubuntu/Documents/School_Work/Linux_Kernel_Programming_Yocto/assignments-3-and-later-KirSpaceB/poky/meta \
  /home/kirbyubuntu/Documents/School_Work/Linux_Kernel_Programming_Yocto/assignments-3-and-later-KirSpaceB/poky/meta-poky \
  /home/kirbyubuntu/Documents/School_Work/Linux_Kernel_Programming_Yocto/assignments-3-and-later-KirSpaceB/poky/meta-yocto-bsp \
  "
```
